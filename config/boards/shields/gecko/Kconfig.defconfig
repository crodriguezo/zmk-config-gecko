## config/boards/shields/gecko/Kconfig.defconfig
```kconfig
if SHIELD_GECKO

config ZMK_KEYBOARD_NAME
    default "gecko"

endif

if ZMK_DISPLAY

config SSD1306
    default y

config I2C
    default y

endif # ZMK_DISPLAY
```

## config/boards/shields/gecko/Kconfig.shield
```kconfig
config SHIELD_GECKO
    def_bool $(shields_list_contains, gecko)

config I2C
    default y

config SSD1306
    default y
```
